## config/west.yml
```yaml
manifest:
  remotes:
    - name: zmk
      url-base: https://github.com/zmkfirmware
  defaults:
    remotes: zmk
  projects:
    - name: zmk
      revision: v0.3.0
      import: true
  self:
    path: config
```
